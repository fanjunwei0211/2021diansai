#include "converse.h"
#include "pid.h"
#include <math.h>
#define pi 3.141592653f


DUTY duty_cycle;  //占空比
				
CLARKE clarke;
PARK park;
ICLARKE iclarke;
IPARK ipark;
SVGENDQ SV_dq;

float iq,id;
//float sin_[361]={0.000000,0.017452,0.034899,0.052336,0.069756,0.087156,0.104528,0.121869,0.139173,0.156434,0.173648,0.190809,0.207912,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-0.017452,0.000000};
//float cos_[361]={1.000000,0.999848,0.999391,0.998630,0.997564,0.996195,0.994522,0.992546,0.990268,0.987688,0.984808,0.981627,0.978148,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0.999848,1.000000};
//float tan_[361]={0.000000,0.017455,0.034921,0.052408,0.069927,0.087489,0.105104,0.122785,0.140541,0.158384,0.176327,0.194380,0.212557,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-0.017455,0.000000};

int ToDegree(float rad)
{
   return (rad*180.0/pi);
}  


/*atan查表*****************************************************************/

#define M_2PI (2 * 3.1415926535897932384626433832795)
#define M_PI 3.1415926535897932384626433832795
#define M_PI_2 (3.1415926535897932384626433832795 / 2)
#define	LUT_NUM		450	/*该值越大表精度越高,精度为atan(1/LUT_NUM)*/

#define Rad_Precision 573

u16 g_atan_tab[LUT_NUM];

#define	ASIN_NUM		450
u16 g_asin_tab[ASIN_NUM];

void atan2_tab_init(void)  
{
	u16 i = 0;

	for (i = 0; i < LUT_NUM; i++)
	{
		g_atan_tab[i] = (u16)(atan((float)i / (LUT_NUM - 1)) * Rad_Precision);
	}
}

/**
* @brief	atan2查表法
* @param[in] y
* @param[in] x
* @note 调用此函数之前需先调用atan2_tab_init()生成表
* @see
* @code
* @retval	返回弧度值
*/
float atan2_tab_calc(float y, float x)
{
	float Y_X, Y_X_temp;
	float result = 0;

	Y_X = (x == 0) ? (float)x / y : (float)y / x;
	Y_X_temp = Y_X;

	if (y == 0)
	{
		if (x >= 0)
			return 0;
		else
			return (M_PI);  //Return Pi
	}
	else if (x > 0 && y > 0)
	{
		//第一象限
		Y_X = (Y_X <= 1) ? Y_X  : 1 / Y_X;
		result = (Y_X_temp > 1)? M_PI_2 - (float)g_atan_tab[(int16_t)(Y_X*(LUT_NUM - 1))] / Rad_Precision : (float)g_atan_tab[(int16_t)(Y_X*(LUT_NUM - 1))] / Rad_Precision;
	}
	else if (x < 0 && y > 0)
	{
		//第二象限
		Y_X = (Y_X < -1)? Y_X = -1 / Y_X : -Y_X;
		result = (Y_X_temp >= -1) ? M_PI - (float)g_atan_tab[(int16_t)(Y_X*(LUT_NUM - 1))] / Rad_Precision : //小于45°
								M_PI_2 + (float)g_atan_tab[(int16_t)(Y_X*(LUT_NUM - 1))] / Rad_Precision;
	}
	else if (x < 0 && y < 0)
	{
		//第三象限
		Y_X = (Y_X <= 1) ? Y_X : 1 / Y_X;
		result = (Y_X_temp <= 1) ? (float)g_atan_tab[(int16_t)(Y_X*(LUT_NUM - 1))] / Rad_Precision - M_PI: -M_PI_2 - (float)g_atan_tab[(int16_t)(Y_X*(LUT_NUM - 1))] / Rad_Precision;
	}
	else if(x > 0 && y < 0)
	{
		//第四象限
		Y_X = (Y_X < -1) ? Y_X = -1 / Y_X : -Y_X;
		result = (Y_X_temp >= -1) ? -(float)g_atan_tab[(int16_t)(Y_X*(LUT_NUM - 1))] / Rad_Precision : //小于45°
								-(M_PI_2 - (float)g_atan_tab[(int16_t)(Y_X*(LUT_NUM - 1))] / Rad_Precision);
	}
	else if(x == 0 && y > 0)
	{
		result = M_PI_2;
	}
	else
	{
		result = -M_PI_2;
	}

	return result;
}
/************************************************************************************************** 
 Function				: clarke_calc;
 Description			: Clark transform;
						  a,b,c -> alpha,beta
 Call by				: functions in TBC;
 Input Variables		: CLARKE
 Output/Return Variables: CL   ARKE
 Subroutine Call		: NONE
 Reference				: NONE
**************************************************************************************************/
void clarke_calc(CLARKE *v)
{	
//   v->ds = v->as;
   v->ds = 0.666666667 * (v->as-(0.5 * v->bs)-(0.5 * v->cs));

   v->qs = (v->bs - v->cs) * (0.57735026918963);
   
}

/************************************************************************************************** 
 Function				: park_calc;
 Description			: Park transform;
						  alpha,beta -> d,q
 Call by				: functions in TBC;
 Input Variables		: PARK
 Output/Return Variables: PARK
 Subroutine Call		: NONE
 Reference				: NONE
**************************************************************************************************/
void park_calc(PARK *v)
{	
  
    float cos_ang,sin_ang;

    /* Using look-up IQ sine table */
     sin_ang = sin_[ToDegree(v->ang)];
     cos_ang = cos_[ToDegree(v->ang)];

	 	
     v->de = (v->ds * cos_ang) + (v->qs * sin_ang);
     v->qe = (v->qs * cos_ang) - (v->ds * sin_ang);
     
}

/************************************************************************************************** 
 Function				: iclarke_calc;
 Description			: Inv Clark transform;
						  alpha,beta -> a,b,c
 Call by				: functions in TBC;
 Input Variables		: ICLARKE
 Output/Return Variables: ICLARKE
 Subroutine Call		: NONE
 Reference				: NONE
**************************************************************************************************/
void iclarke_calc(ICLARKE *v)
{	

     v->as = v->ds;
     v->bs = ((-0.5) * v->ds) + ((0.86602540) * v->qs);
     v->cs = ((-0.5) * v->ds) - ((0.86602540) * v->qs);
    
}

/************************************************************************************************** 
 Function				: ipark_calc;
 Description			: Inv Park transform;
						  d,q -> alpha,beta 
 Call by				: functions in TBC;
 Input Variables		: IPARK
 Output/Return Variables: IPARK
 Subroutine Call		: NONE
 Reference				: NONE
**************************************************************************************************/
void ipark_calc(IPARK *v)
{	
   
   float cos_ang,sin_ang;
   
/* Using look-up IQ sine table */  
     sin_ang = sin_[ToDegree(v->ang)];
     cos_ang = cos_[ToDegree(v->ang)];
 
     v->ds = (v->de * cos_ang) - (v->qe * sin_ang);
     v->qs = (v->qe * cos_ang) + (v->de * sin_ang);
}

///**************************************************************************************************
// Function				: svgendq_calc;
// Description			: SV pwm generation;
// Call by				: functions in TBC;
// Input Variables		: Valpha,Vbeta,Vdc
// Output/Return Variables: a,b,c PWM ratio
// Subroutine Call		: NONE
// Reference				: NONE
//**************************************************************************************************/
//void svgendq_calc(SVGENDQ *v)
//{

//	float Va,Vb,Vc,t1,t2,a,b;
//	u32 Sector = 0;  // Sector is treated as Q0 - independently with global Q
///*	long Sector3[2][2] = {{_IQ(1.5),_IQ(-0.8660)},{_IQ(0),_IQ(1.7321)}};
//	long Sector1[2][2] = {{_IQ(-1.5),_IQ(0.8660)},{_IQ(1.5),_IQ(0.8660)}};
//	long Sector5[2][2] = {{_IQ(0),_IQ(1.7321)},{_IQ(-1.5),_IQ(-0.8660)}};
//	long Sector4[2][2] = {{_IQ(0),_IQ(-1.7321)},{_IQ(-1.5),_IQ(0.8660)}};
//	long Sector6[2][2] = {{_IQ(-1.5),_IQ(-0.8660)},{_IQ(1.5),_IQ(-0.8660)}};
//	long Sector2[2][2] = {{_IQ(1.5),_IQ(0.8660)},{_IQ(0),_IQ(-1.7321)}};
//*/
////TI
//	float Sector3[2][2] = {{(0.8660),(-0.5)},{(0),(1)}};
//	float Sector1[2][2] = {{(-0.8660),(0.5)},{(0.8660),(0.5)}};
//	float Sector5[2][2] = {{(0),(1)},{(-0.8660),(-0.5)}};
//	float Sector4[2][2] = {{(0),(-1)},{(-0.8660),(0.5)}};
//	float Sector6[2][2] = {{(-0.8660),(-0.5)},{(0.8660),(-0.5)}};
//	float Sector2[2][2] = {{(0.8660),(0.5)},{(0),(-1)}};

//// Vdc feedforward
//#if 0
//	if(v->UdcIn == 0)
//	{
//		v->UdcIn = 1;
//	}

//	v->Ualfa = _IQdiv(v->UalfaIn,v->UdcIn);
//	v->Ubeta = _IQdiv(v->UbetaIn,v->UdcIn);
//#endif

//#if 1
//	v->Ualfa = v->UalfaIn;
//	v->Ubeta = v->UbetaIn;
//#endif

//// Inverse clarke transformation
//    Va = v->Ubeta;
//    Vb = ((-0.5) * v->Ubeta) + ((0.8660254) * v->Ualfa);  // 0.8660254 = sqrt(3)/2
//    Vc = ((-0.5) * v->Ubeta) - ((0.8660254) * v->Ualfa);  // 0.8660254 = sqrt(3)/2

//// 60 degree Sector determination
//    if (Va>(0))
//       Sector = 1;
//    if (Vb>(0))
//       Sector = Sector + 2;
//    if (Vc>(0))
//       Sector = Sector + 4;

//    //v->Sector_Flag = Sector * 2000;


//// X,Y,Z (Va,Vb,Vc) calculations

//    if (Sector==0)  // Sector 0: this is special case for (Ualpha,Ubeta) = (0,0)
//    {
//       v->Ta = 0.5;
//       v->Tb = 0.5;
//       v->Tc = 0.5;
//    }
//    if (Sector==1)  // Sector 1: t1=Z and t2=Y (abc ---> Tb,Ta,Tc)
//    {
//       t1 = (Sector1[0][0] * v->Ualfa) + (Sector1[0][1] * v->Ubeta);
//       t2 = (Sector1[1][0] * v->Ualfa) + (Sector1[1][1] * v->Ubeta);
//       if((t1+t2)>(0.99))
//       {
//           a = t1;
//           b = t2;
//          t1 = (a * 0.99) / (a+b);
//          t2 = (b * 0.99) / (a+b);
//       }
//       v->Tb = 0.5 * (1-t1-t2);      // tbon = (1-t1-t2)/2
//       v->Ta = v->Tb + t1;                             // taon = tbon+t1
//       v->Tc = v->Ta + t2;                             // tcon = taon+t2
//    }
//    else if (Sector==2)  // Sector 2: t1=Y and t2=-X (abc ---> Ta,Tc,Tb)
//    {
//       t1 = (Sector2[0][0] * v->Ualfa) + (Sector2[0][1] * v->Ubeta);
//       t2 = (Sector2[1][0] * v->Ualfa) + (Sector2[1][1] * v->Ubeta);
//       if((t1+t2)>(0.99))
//       {
//           a = t1;
//           b = t2;
//          t1 = (a * 0.99) / (a+b);
//          t2 = (b * 0.99) / (a+b);
//       }
//       v->Ta = (0.5) * (1-t1-t2);      // taon = (1-t1-t2)/2
//       v->Tc = v->Ta+t1;                             // tcon = taon+t1
//       v->Tb = v->Tc+t2;                             // tbon = tcon+t2
//    }
//    else if (Sector==3)  // Sector 3: t1=-Z and t2=X (abc ---> Ta,Tb,Tc)
//    {
//       t1 = (Sector3[0][0] * v->Ualfa) + (Sector3[0][1] * v->Ubeta);
//       t2 = (Sector3[1][0] * v->Ualfa) + (Sector3[1][1] * v->Ubeta);
//       if((t1+t2)>(0.99))
//       {
//           a = t1;
//           b = t2;
//          t1 = (a * 0.99) / (a+b);
//          t2 = (b * 0.99) / (a+b);
//       }
//       v->Ta = (0.5) * (1-t1-t2);      // taon = (1-t1-t2)/2
//       v->Tb = v->Ta+t1;                             // tbon = taon+t1
//       v->Tc = v->Tb+t2;                             // tcon = tbon+t2
//    }
//    else if (Sector==4)  // Sector 4: t1=-X and t2=Z (abc ---> Tc,Tb,Ta)
//    {
//       t1 = (Sector4[0][0] * v->Ualfa) + (Sector4[0][1] * v->Ubeta);
//       t2 = (Sector4[1][0] * v->Ualfa) + (Sector4[1][1] * v->Ubeta);
//       if((t1+t2)>(0.99))
//       {
//           a = t1;
//           b = t2;
//          t1 = (a * 0.99) / (a+b);
//          t2 = (b * 0.99) / (a+b);
//       }
//       v->Tc = (0.5) * (1-t1-t2);      // tcon = (1-t1-t2)/2
//       v->Tb = v->Tc+t1;                             // tbon = tcon+t1
//       v->Ta = v->Tb+t2;                             // taon = tbon+t2
//    }
//    else if (Sector==5)  // Sector 5: t1=X and t2=-Y (abc ---> Tb,Tc,Ta)
//    {
//       t1 = (Sector5[0][0] * v->Ualfa) + (Sector5[0][1] * v->Ubeta);
//       t2 = (Sector5[1][0] * v->Ualfa) + (Sector5[1][1] * v->Ubeta);
//       if((t1+t2)>(0.99))
//       {
//           a = t1;
//           b = t2;
//          t1 = (a * 0.99) / (a+b);
//          t2 = (b * 0.99) / (a+b);
//       }
//       v->Tb = (0.5) * (1-t1-t2);      // tbon = (1-t1-t2)/2
//       v->Tc = v->Tb+t1;                             // tcon = tbon+t1
//       v->Ta = v->Tc+t2;                             // taon = tcon+t2
//    }
//    else if (Sector==6)  // Sector 6: t1=-Y and t2=-Z (abc ---> Tc,Ta,Tb)
//    {
//       t1 = (Sector6[0][0] * v->Ualfa) + (Sector6[0][1] * v->Ubeta);
//       t2 = (Sector6[1][0] * v->Ualfa) + (Sector6[1][1] * v->Ubeta);
//       if((t1+t2)>(0.99))
//       {
//           a = t1;
//           b = t2;
//          t1 = (a * 0.99) / (a+b);
//          t2 = (b * 0.99) / (a+b);
//       }
//       v->Tc = (0.5) * (1-t1-t2);      // tcon = (1-t1-t2)/2
//       v->Ta = v->Tc+t1;                             // taon = tcon+t1
//       v->Tb = v->Ta+t2;                             // tbon = taon+t2
//    }

//}
void Tri_compare(DUTY *duty_cycle,ICLARKE *iclarke)
{
	float highest=3;     //随便设的三角波最值
	if(highest>fabs(iclarke->as)&&highest>fabs(iclarke->bs)&&highest>fabs(iclarke->cs))
	{
		duty_cycle->duty1=(iclarke->as+highest)/(highest-iclarke->as);
		duty_cycle->duty2=(iclarke->bs+highest)/(highest-iclarke->bs);
		duty_cycle->duty3=(iclarke->cs+highest)/(highest-iclarke->cs);
	}
	else
	{
		//error
	}
}	

c


/*	//pid初始化
	PID_init(&pid1, PID_DELTA, PID1, 4.1, 1, 0.1);
PID_init(&pid2, PID_DELTA, PID2, 100, 100, 0.1);
PID_init(&pid3, PID_DELTA, PID3, 100, 100, 0.1);
*/















